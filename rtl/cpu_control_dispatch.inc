9'b000000000: state <= 0;
9'b001110110: state <= 2;
9'b001???110: state <= 3;
9'b001110???: state <= 4;
9'b000110110: state <= 5;
9'b001??????: state <= 7;
9'b000???110: state <= 8;
9'b000??0001: state <= 9;
9'b000100010: state <= 11;
9'b000101010: state <= 12;
9'b000110010: state <= 13;
9'b000111010: state <= 14;
9'b011???110: state <= 15;
9'b010???110: state <= 17;
9'b010??????: state <= 19;
9'b011000011: state <= 20;
9'b011101001: state <= 23;
9'b0110??010: state <= 24;
9'b000??0010: state <= 27;
9'b000??1010: state <= 28;
9'b011101010: state <= 29;
9'b011111010: state <= 32;
9'b011100000: state <= 35;
9'b011100010: state <= 37;
9'b011110000: state <= 38;
9'b011110010: state <= 40;
9'b000??0011: state <= 41;
9'b000??1011: state <= 42;
9'b000001000: state <= 43;
9'b011111001: state <= 47;
9'b011110101: state <= 49;
9'b011110001: state <= 52;
9'b011??0101: state <= 54;
9'b011??0001: state <= 57;
9'b000??1001: state <= 59;
9'b011101000: state <= 61;
9'b011111000: state <= 64;
9'b000011000: state <= 67;
9'b0001??000: state <= 70;
9'b011001101: state <= 72;
9'b0110??100: state <= 78;
9'b011001001: state <= 81;
9'b0110??000: state <= 84;
9'b011011001: state <= 86;
9'b000110100: state <= 89;
9'b000???100: state <= 91;
9'b000110101: state <= 92;
9'b000???101: state <= 94;
9'b000???111: state <= 95;
9'b011001011: state <= 96;
9'b100???110: state <= 97;
9'b100??????: state <= 99;
9'b101???110: state <= 100;
9'b1?????110: state <= 102;
9'b1????????: state <= 104;
9'b011111011: state <= 105;
9'b011110011: state <= 106;
9'b011???111: state <= 107;
